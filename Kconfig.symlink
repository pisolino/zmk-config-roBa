## Kconfig.symlink
```kconfig
source "$(ZEPHYR_ZMKB_MODULE_DIR)/modules/zmk-behavior-pmw3610-profile/Kconfig" 
```

## config/dts/bindings/behaviors/zmk,behavior-pmw3610-profile.yaml
```yaml
# Copyright (c) 2024 The ZMK Contributors
# SPDX-License-Identifier: MIT

description: PMW3610 Profile Switching behavior

compatible: "zmk,behavior-pmw3610-profile"

include: zero_param.yaml

properties:
  profile-type:
    type: string
    required: true
    enum:
      - "precision"
      - "speed"
```

## config/modules/zmk-behavior-pmw3610-profile/Kconfig
```kconfig
config ZMK_BEHAVIOR_PMW3610_PROFILE
    bool "Support for PMW3610 profile switching behavior"
    depends on PMW3610_PROFILE_SWITCHING
    default y
    help
      Support for PMW3610 profile switching behavior that allows on-the-fly
      switching between precision and speed profiles. 
```

## config/west.yml
```yaml
manifest:
  remotes:
    - name: zmkfirmware
      url-base: https://github.com/zmkfirmware
    - name: kumamuk-git
      url-base: https://github.com/kumamuk-git
    - name: pisolino
      url-base: https://github.com/pisolino
  projects:
    - name: zmk
      remote: zmkfirmware
      revision: v0.3.0
      import: app/west.yml
    - name: zmk-pmw3610-driver
      remote: pisolino
      revision: main
  self:
    path: config
```
